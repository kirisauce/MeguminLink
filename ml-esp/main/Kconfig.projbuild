## ml-esp/main/Kconfig.projbuild
```kconfig
menu "MeguminLink"

menu "Debug Probe (CMSIS-DAP)"

config MEGUMINLINK_PACKET_BUFFER_DEPTH
    int "Packet buffer depth"
    default 8
    help
        Depth of the USB bulk RX ringbuffer (USB targets) and, at the same
        time, the CMSIS-DAP DAP_PACKET_COUNT (see DAP_config.h). Kept
        available on non-USB targets (e.g. wireless receiver ESP32-C3).

config MEGUMINLINK_DAP_SWCLK_IO
    int "CMSIS-DAP SWCLK/TCK GPIO number"
    default 4
    help
        SWD/JTAG I/O pins of the CMSIS-DAP core. Used both by the local
        (USB) CMSIS-DAP implementation and by the wireless target-side
        executor, so these are available on every target (including
        non-USB ones like ESP32-C3 used as the wireless receiver).

config MEGUMINLINK_DAP_SWDIO_IO
    int "CMSIS-DAP SWDIO/TMS GPIO number"
    default 5

config MEGUMINLINK_DAP_NRESET_IO
    int "CMSIS-DAP nRESET GPIO number"
    default 6
    help
        Target device reset line. The JTAG nTRST signal shares this GPIO
        (DAP_nTRST_GPIO aliases DAP_nRESET_GPIO).

config MEGUMINLINK_DAP_TDI_IO
    int "CMSIS-DAP TDI GPIO number"
    default 7

config MEGUMINLINK_DAP_TDO_IO
    int "CMSIS-DAP TDO GPIO number"
    default 8

config MEGUMINLINK_DAP_SWO_IO
    int "CMSIS-DAP SWO GPIO number"
    default 7
    help
        SWO trace capture pin (SWO UART mode, receive only). Only the local
        (USB) CMSIS-DAP implementation captures SWO; the wireless executor
        has no SWO hardware. The capture runs on UART2, so the UART bridge
        (UART1 by default) must not be moved to port 2.

endmenu

config MEGUMINLINK_USB_SUPPORT
    bool "Enable USB (TinyUSB) support"
    default y
    depends on IDF_TARGET_ESP32S3
    help
        Compile the USB/TinyUSB support code. The USB OTG
        peripheral is only available on ESP32-S3, so this option is only
        configurable when building for that target; on other targets the
        file is always excluded from the build.
        When disabled, the Local (USB CMSIS-DAP) mode is unavailable: the
        device always runs in Wireless mode, a stored Local mode in NVS is
        corrected to Wireless on boot, and the mode switch button cannot
        switch to Local.

menu "USB (TinyUSB)"
    depends on MEGUMINLINK_USB_SUPPORT

config MEGUMINLINK_USB_MAX_PACKET_SIZE
    int "USB max packet size"
    default 512

config MEGUMINLINK_USB_UART_BRIDGE_ENABLE
    bool "Enable UART bridge (CDC ACM)"
    default y
    help
        Compile the UART bridge and expose a CDC ACM interface on USB.
        When disabled, the USB device only exposes the CMSIS-DAP
        interface and no serial port is visible to the host.

config MEGUMINLINK_USB_HID_DAP_ENABLE
    bool "Compile CMSIS-DAP v1 (HID) transport"
    default y
    depends on TINYUSB_HID_COUNT > 0
    help
        Compile the CMSIS-DAP v1 transport: the HID interface descriptor
        (vendor-defined 64-byte reports, interrupt IN/OUT endpoints), its
        report callbacks and the HID response path.

        This is the build-time master switch for the runtime HID
        compatibility mode, which decides whether that HID interface is
        exposed to the host. That state lives in NVS, defaults to off, and
        is flipped over the config channel (GetUsbConfig 0x03 /
        SetUsbConfig 0x16 / ApplyUsbConfig 0x17). Turning it on lets hosts
        that only speak CMSIS-DAP v1 over HID (some Keil versions) use the
        probe; v2 hosts over the vendor bulk interface are unaffected.

        When off, the v1 transport is not compiled in, the HID interface is
        never exposed and the runtime mode cannot be enabled (it is rejected
        as unsupported).

        Both transports share one DAP execution loop, so a host should use
        only one of them at a time.

        Requires TinyUSB HID class support: TINYUSB_HID_COUNT > 0 (set to 1
        by sdkconfig.defaults; the option is hidden otherwise).

config MEGUMINLINK_USB_WEBUSB_CAPABILITY_ENABLE
    bool "Enable WebUSB capability"
    default y
    help
        Compile the WebUSB platform capability. This is the build-time
        master switch: when off, the capability never appears in the BOS
        descriptor, the WebUSB GET_URL vendor request is not answered, and
        the runtime switch (config channel command 0x16) cannot enable it.

        When on, whether the capability is advertised is a runtime state
        stored in NVS: enabled by default, flip it over the config channel
        (GetUsbConfig 0x03 / SetUsbConfig 0x16 / ApplyUsbConfig 0x17), which
        rebuilds the descriptors and re-enumerates USB.

config MEGUMINLINK_USB_WEBUSB_LANDING_PAGE
    string "WebUSB landing page"
    default "https://example.com"
    depends on MEGUMINLINK_USB_WEBUSB_CAPABILITY_ENABLE
    help
        Default landing page URL: used when NVS holds no URL record and when
        an empty URL is submitted over the config channel. The runtime value
        lives in NVS and appears both as USB string iLandingPage and in the
        WebUSB GET_URL response.

        A leading "https://" or "http://" is stripped from the URL descriptor
        body and encoded as its scheme; any other form is embedded verbatim
        (scheme = full URL). At most 126 characters (the WebUSB string
        descriptor limit).

config MEGUMINLINK_USB_WINUSB_CAPABILITY_ENABLE
    bool "Enable WinUSB capability"
    default y
    help
        Compile the Microsoft OS 2.0 platform capability. This is the
        build-time master switch: when off, the capability never appears in
        the BOS descriptor, the MS OS 2.0 descriptor set is not served, and
        the runtime switch (config channel command 0x16) cannot enable it.

        When on, Windows binds winusb.sys to the CMSIS-DAP vendor interface
        (no manual driver installation) while the runtime state is enabled;
        the state lives in NVS, is enabled by default, and is flipped over
        the config channel.

endmenu

menu "UART Bridge"

# UART 桥参数：USB 侧本地桥（S3）与目标侧无线 UART 桥（C3）共用同一套
# 参数。放在 USB 条件之外，非 USB 端（如 ESP32-C3 无线接收端）也能配置。
config MEGUMINLINK_UART_RX_BUFFER_SIZE
    int "UART receive buffer size"
    default 256

config MEGUMINLINK_UART_TX_BUFFER_SIZE
    int "UART send buffer size"
    default 256

config MEGUMINLINK_UART_EVENT_QUEUE_SIZE
    int "UART event queue size"
    default 16

config MEGUMINLINK_UART_BRIDGE_NUM
    int "UART bridge peripheral num"
    default 1
    range 1 2

config MEGUMINLINK_UART_BRIDGE_TX_IO
    int "UART bridge TX GPIO number"
    default 17

config MEGUMINLINK_UART_BRIDGE_RX_IO
    int "UART bridge RX GPIO number"
    default 18

config MEGUMINLINK_UART_BRIDGE_BAUD_RATE
    int "UART bridge baud rate"
    default 115200

config MEGUMINLINK_UART_TX_MAX_BPS
    int "Wireless UART egress rate cap (bit/s)"
    default 115200
    help
        Upper bound for port data entering the wireless link, expressed as the
        line rate the far end UART is expected to drain. The bridge admits one
        tenth of this value in bytes per second, so the default suits a 115200
        baud peer.

config MEGUMINLINK_UART_TX_MIN_PERCENT
    int "Wireless UART share while DAP is busy (percent)"
    default 25
    range 0 100
    help
        Share of the egress cap still granted to port data while reliable DAP
        traffic has messages in flight. 0 stops port data entirely for the
        duration of DAP activity, 100 disables DAP priority.

config MEGUMINLINK_UART_INBOUND_QUEUE_DEPTH
    int "Inbound UART frame queue depth (frames)"
    default 8
    help
        Frames the peer-facing receive callback may hand to the bridge before it
        has written them to this side's port. The callback never writes the UART
        itself, so a full queue drops the frame and counts it instead of blocking
        the WiFi task.

endmenu

menu "Wireless"

config MEGUMINLINK_WIRELESS_RESPONSE_TIMEOUT_MS
    int "Wireless DAP response timeout (ms)"
    default 1800
    range 10 5000
    help
        How long the USB-side (sender) waits for a wireless DAP response
        after forwarding a command to the paired peer before giving up. This
        is the outer wall for the whole attempt: the reliable transport's
        retransmission budget (initial RTO plus backoff) elapses inside it,
        and only when that budget is exhausted is the command dropped and the
        PC-side debugger left to see a command timeout and retry on its own.

config MEGUMINLINK_WIRELESS_LOSS_SIM_ENABLE
    bool "Enable wireless link loss simulation (test facility)"
    default n
    help
        Compile the loss injection facility: the sending side drops DAP and
        UART data frames at a rate settable from the host (config channel
        command 0x1A, percent of frames), emulating a degraded radio link so
        the DAP timeout and dropped-UART-byte paths can be exercised on
        demand.

        Only DAP and UART data frames are subject to injection. Pairing,
        liveness probes and config-channel control frames always go through,
        so even the highest rate can always be turned off again from the
        host. The rate is not persisted and returns to zero on boot and on
        factory reset.

        Enable this on BOTH ends of the link: each side drops its own
        outbound frames, so enabling it on one side only degrades a single
        direction.

        When disabled no injection code, parameter, counter or protocol
        command is compiled in: the command code falls through to
        UnknownCommand and GetConfig/GetStats carry no loss tags.

endmenu

config MEGUMINLINK_MODE_SWITCH_ENABLE
    bool "Enable debug mode switch button (double click + long press)"
    default y
    help
        Double click toggles between local (USB CMSIS-DAP) and wireless
        debug modes (with USB support disabled, Local is unavailable and
        the toggle is a silent no-op, leaving the device in Wireless); a
        long press (in wireless mode) enters pairing mode.
        Disable to strip the button driver (e.g. when the GPIO is needed
        for something else).

menu "Mode Switch Button"
    depends on MEGUMINLINK_MODE_SWITCH_ENABLE

config MEGUMINLINK_MODE_SWITCH_GPIO
    int "Mode switch button GPIO number"
    default 0
    range 0 48
    help
        Button GPIO, active low (internal pull-up, falling edge on press).
        Default GPIO0 (BOOT button). Note: GPIO0 is a strapping pin - holding
        it low during power-up enters ROM download mode.

config MEGUMINLINK_MODE_SWITCH_DOUBLE_CLICK_MS
    int "Mode switch double-click window (ms)"
    default 400
    help
        Maximum interval between two presses (falling edges) to count as a
        double click.

config MEGUMINLINK_MODE_SWITCH_LONG_PRESS_MS
    int "Mode switch button long-press threshold (ms)"
    default 1700
    range 300 5000
    help
        Hold the button this long (in wireless mode, when already paired) to
        manually re-enter the pairing flow. Auto pairing (no peer in NVS) is
        already running in that case, so the press is ignored. Must be longer
        than the double-click window. In local mode a long press is ignored.

config MEGUMINLINK_PAIRING_MODE_TIMEOUT_MS
    int "Manual pairing timeout (ms)"
    default 60000
    range 1000 300000
    help
        How long a manually entered pairing flow stays active before
        automatically leaving it (restoring the previous pairing). Any
        button press also leaves it immediately. Auto pairing (no peer in
        NVS) is not affected and only ends on success. The NVS pairing
        record is never erased by entering/leaving the pairing flow.

endmenu

choice MEGUMINLINK_LED_DRIVER
    prompt "LED indicator driver"
    default MEGUMINLINK_LED_DRIVER_GPIO
    help
        Select the LED indicator driver. "Disabled" removes the whole LED
        module from the build. GPIO drives two LEDs (default GPIO12/GPIO13,
        active low). WS2812 drives a single addressable LED on the RMT
        peripheral (default GPIO1).

config MEGUMINLINK_LED_DRIVER_NONE
    bool "Disabled"
    help
        Do not compile the LED indicator module.

config MEGUMINLINK_LED_DRIVER_GPIO
    bool "GPIO direct drive (2 LEDs)"
    help
        Two LEDs on plain GPIOs, active-low by default. LED1 (mode
        indicator) and LED2 (pairing/connection indicator) GPIO numbers
        are configured below.

config MEGUMINLINK_LED_DRIVER_WS2812
    bool "WS2812 (RMT, 1 LED)"
    help
        One WS2812 addressable LED driven by the RMT peripheral (protocol
        sampling: bit0 = 300ns high/900ns low, bit1 = 700ns high/500ns
        low, GRB byte order). The single LED encodes the device status
        (mode/pairing) with color and effect (see led_types.hpp).

endchoice

menu "LED Indicator (GPIO)"

config MEGUMINLINK_LED_DRIVER_GPIO_LED1_IO
    int "LED1 (mode) GPIO number"
    default 12

config MEGUMINLINK_LED_DRIVER_GPIO_LED2_IO
    int "LED2 (pairing/connection) GPIO number"
    default 13

config MEGUMINLINK_LED_DRIVER_GPIO_ACTIVE_LOW
    bool "LEDs active low (low level lights the LED)"
    default y
    help
        Enable for boards where the LED cathode is connected to the GPIO
        (LED on = GPIO output low). Disable for active-high boards.

config MEGUMINLINK_LED_DRIVER_GPIO_BLINK_PERIOD_MS
    int "Blink half-period (ms)"
    default 250
    range 50 2000
    help
        Half of one full blink cycle: a blinking LED toggles every this
        many milliseconds.

endmenu

menu "LED Indicator (WS2812)"

config MEGUMINLINK_LED_DRIVER_WS2812_GPIO
    int "WS2812 data (DIN) GPIO number"
    default 1
    range 0 48
    help
        GPIO connected to the single WS2812 LED's DIN pin. The RMT
        peripheral drives this pin with the WS2812 protocol.

endmenu

endmenu
```

## ml-esp/sdkconfig.defaults.esp32c3
```kconfig
# 合宙ESP32C3-CORE开发板
CONFIG_MEGUMINLINK_MODE_SWITCH_GPIO=9
CONFIG_MEGUMINLINK_UART_BRIDGE_TX_IO=10
CONFIG_MEGUMINLINK_UART_BRIDGE_RX_IO=3
```

## ml-esp/sdkconfig.defaults.s3-devboard
```kconfig
# MeguminLink S3 DevBoard：BOOT 键（IO0）作模式切换，板载 WS2812 数据在 IO48
CONFIG_MEGUMINLINK_MODE_SWITCH_GPIO=0
CONFIG_MEGUMINLINK_LED_DRIVER_WS2812_GPIO=48
# 板上 CMSIS-DAP（SWD/JTAG）与串口桥引脚
CONFIG_MEGUMINLINK_DAP_SWCLK_IO=17
CONFIG_MEGUMINLINK_DAP_SWDIO_IO=18
CONFIG_MEGUMINLINK_DAP_NRESET_IO=6
CONFIG_MEGUMINLINK_DAP_TDI_IO=15
CONFIG_MEGUMINLINK_DAP_TDO_IO=16
CONFIG_MEGUMINLINK_UART_BRIDGE_TX_IO=4
CONFIG_MEGUMINLINK_UART_BRIDGE_RX_IO=5
```

## ml-esp/sdkconfig.defaults.s3-pv2
```kconfig
# MeguminLink S3 PV2 板：模式切换按钮 IO35，板载 WS2812 数据在 IO9
CONFIG_MEGUMINLINK_MODE_SWITCH_GPIO=35
CONFIG_MEGUMINLINK_LED_DRIVER_WS2812_GPIO=9
# 板上 CMSIS-DAP（SWD/JTAG）与串口桥引脚
CONFIG_MEGUMINLINK_DAP_SWCLK_IO=17
CONFIG_MEGUMINLINK_DAP_SWDIO_IO=18
CONFIG_MEGUMINLINK_DAP_NRESET_IO=6
CONFIG_MEGUMINLINK_DAP_TDI_IO=15
CONFIG_MEGUMINLINK_DAP_TDO_IO=16
CONFIG_MEGUMINLINK_UART_BRIDGE_TX_IO=4
CONFIG_MEGUMINLINK_UART_BRIDGE_RX_IO=5
```
